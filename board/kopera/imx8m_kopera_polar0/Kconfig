## board/kopera/imx8m_kopera_polar0/Kconfig
```kconfig
if TARGET_IMX8M_KOPERA_POLAR0

config SYS_BOARD
	default "imx8m_kopera_polar0"

config SYS_VENDOR
	default "kopera"

config SYS_CONFIG_NAME
	default "imx8m_kopera_polar0"

source "board/freescale/common/Kconfig"

endif
```
